## project-spec/configs/rootfsconfigs/Kconfig.user
```kconfig
menu "user packages " 
config clk-dglnt-dynclk  
	 bool "clk-dglnt-dynclk"
	 help
	
config digilent-hdmi  
	 bool "digilent-hdmi"
	 help
	
config gpio-demo  
	 bool "gpio-demo"
	 help
	
config peekpoke  
	 bool "peekpoke"
	 help
	
config vga-connector-minimal  
	 bool "vga-connector-minimal"
	 help
	
endmenu
```
